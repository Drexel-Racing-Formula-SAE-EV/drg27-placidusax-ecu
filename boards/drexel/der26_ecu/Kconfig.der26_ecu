## boards/drexel/der26_ecu/Kconfig.der26_ecu
```kconfig
# SPDX-License-Identifier: Apache-2.0

config BOARD_DER26_ECU
    select SOC_STM32F767XX
```

## boards/drexel/der26_ecu/board.yml
```yaml
board:
  name: der26_ecu
  full_name: Drexel Racing DER26 Vehicle Electronic Control Unit
  vendor: others
  socs:
    - name: stm32f767xx
```

## dts/bindings/ecu/drexel,ecu-safety-io.yaml
```yaml
title: MCU Breakout rev1 board-owned outputs

description: |
  The outputs on MCU Breakout rev1 that the board-owned fail-low primitive
  drives to a low push-pull level before the kernel exists and after a fatal
  error.

  Signals are named by SCHEMATIC NET, not by function. MCU Breakout rev1 is
  shared between the AMS and the ECU: Firmware_Ok, MTR_EN and Buzzer are named
  on the schematic, while MISC_IO4 and GP_OUT6 are generic nets whose function
  is assigned downstream on ECU Backplane rev2 and the mezzanines.

  The board layer holds NO polarity opinion. Every flags cell here must be
  zero, which means "no opinion" rather than "active high". The GPIO_ACTIVE_*
  flag for a net belongs in the ECU application layer, which is the layer that
  knows what the net drives.

  TODO(E-009): map pump -> GP_OUT6 in the application layer and decide its
  flag there. Blocked on whether the downstream gate stage inverts, and on
  whether an external pull defines the state while the MCU is in reset.

compatible: "drexel,ecu-safety-io"

include: base.yaml

properties:
  firmware-ok-gpios:
    type: phandle-array
    required: true
    description: PA7, net Firmware_Ok, J801.12. Schematic-named.

  mtr-en-gpios:
    type: phandle-array
    required: true
    description: PF10, net MTR_EN, J801.6. Schematic-named.

  buzzer-gpios:
    type: phandle-array
    required: true
    description: PF13, net Buzzer, J801.14. Schematic-named.

  misc-io4-gpios:
    type: phandle-array
    required: true
    description: |
      PA5, net MISC_IO4, J801.10. Generic. The v2.10.7 oracle drives this as
      Cascadia_ON; the schematic does not corroborate that name.

  gp-out6-gpios:
    type: phandle-array
    required: true
    description: |
      PB8, net GP_OUT6, J801.29. Generic. The v2.10.7 oracle drives this as the
      coolant pump S gate and claims the path inverts; the schematic does not
      corroborate either. Unverified.
```
