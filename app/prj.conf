## CMakeLists.txt
```
cmake_minimum_required(VERSION 3.20.0)

get_filename_component(DRG27_ECU_ROOT "${CMAKE_CURRENT_SOURCE_DIR}/.." ABSOLUTE)
list(APPEND BOARD_ROOT "${DRG27_ECU_ROOT}")
list(APPEND DTS_ROOT "${DRG27_ECU_ROOT}")

find_package(Zephyr REQUIRED HINTS $ENV{ZEPHYR_BASE})
project(drg27_placidusax_ecu)

target_sources(app PRIVATE
    src/main.c
    src/ecu_fatal.c
)

target_include_directories(app PRIVATE
    "${DRG27_ECU_ROOT}/include"
)

# ---------------------------------------------------------------------------
# Portable ECU core
# ---------------------------------------------------------------------------
#
# Kept as ordinary CMake.  lib/ecu_core/CMakeLists.txt contains no Zephyr
# helpers and is reused verbatim by the null-platform host gate.  Platform
# integration points *toward* this core, never the reverse.
get_filename_component(
    ECU_CORE_DIR
    "${CMAKE_CURRENT_SOURCE_DIR}/../lib/ecu_core"
    ABSOLUTE
)

add_subdirectory(
    "${ECU_CORE_DIR}"
    "${CMAKE_BINARY_DIR}/ecu_core"
)

# drivers/ecu is intentionally NOT added here.  This repository is a Zephyr
# module and zephyr/CMakeLists.txt creates ecu_platform while Zephyr is still
# in kernel CMake mode.  Calling zephyr_library_named() from this application
# CMakeLists would happen too late (application mode).
if(NOT TARGET ecu_platform)
    message(FATAL_ERROR
        "ecu_platform Zephyr module library was not created; "
        "check zephyr/module.yml and zephyr/CMakeLists.txt")
endif()

# The DER26 board CMakeLists is discovered and processed by Zephyr as part of
# board handling. Never add the board directory manually from the app: doing so
# instantiates ecu_board_safety twice and violates board-source ownership.
if(NOT TARGET ecu_board_safety)
    message(FATAL_ERROR
        "ecu_board_safety was not created by the DER26 ECU board CMake integration")
endif()

# Platform adapters may consume portable ECU types/functions.  The portable
# core itself never receives a dependency back on the platform or Zephyr.
target_link_libraries(ecu_platform PRIVATE ecu_core)
target_link_libraries(app PRIVATE ecu_core)
```

## Kconfig
```
mainmenu "DRG27 Placidusax ECU"

source "Kconfig.zephyr"

menu "DRG27 ECU migration authority policy"

# ---------------------------------------------------------------------------
# Authority locks
# ---------------------------------------------------------------------------
#
# These correspond to ECU_OUTPUTS_INHIBITED in the v2.10.7 oracle's
# ecu_config.h.  The oracle inhibits propulsion outputs in every profile except
# ECU_BUILD_PROFILE_VEHICLE.  During the migration all three remain disabled;
# each is additionally backstopped by a C BUILD_ASSERT at the stage that
# introduces the corresponding output writer.

config ECU_TORQUE_AUTHORITY
    bool "Permit nonzero torque request authority"
    default n
    help
      Controls whether the application may command a nonzero CM200 torque
      request. MUST remain disabled for the whole migration until E-018.

config ECU_INVERTER_ENABLE_AUTHORITY
    bool "Permit CM200 hardware enable authority (MTR_EN / Cascadia_ON)"
    default n
    help
      Controls whether the application may assert the two CM200 hardware
      enable outputs. MUST remain disabled for the whole migration until E-018.

config ECU_FIRMWARE_OK_AUTHORITY
    bool "Permit Firmware_Ok shutdown-circuit authority"
    default n
    help
      Controls whether the application may drive Firmware_Ok high. This is a
      shutdown-circuit participant; it remains disabled until the safety
      supervisor and watchdog stages are validated.

endmenu

menu "DRG27 ECU release evidence gates"

# ---------------------------------------------------------------------------
# One-for-one translation of the v2.10.7 ecu_config.h evidence gates.
# ---------------------------------------------------------------------------
#
# Each corresponds to an independently reviewable artifact and may NOT be
# replaced by one generic release switch. Enabling all of them is necessary but
# not sufficient for vehicle authority; the authority locks above are separate.

config ECU_PINMAP_VALIDATED
    bool "Claim validated pin map"
    default n

config ECU_APPS_CALIBRATION_VALIDATED
    bool "Claim validated APPS calibration"
    default n

config ECU_BSE_CALIBRATION_VALIDATED
    bool "Claim validated brake calibration"
    default n

config ECU_DISCRETE_INPUTS_VALIDATED
    bool "Claim validated protected discrete inputs"
    default n

config ECU_AMS_PROTOCOL_VALIDATED
    bool "Claim validated AMS CAN protocol behavior"
    default n

config ECU_CURRENT_MODEL_VALIDATED
    bool "Claim validated pack-current model"
    default n

config ECU_CURRENT_RESIDUAL_VALIDATED
    bool "Claim validated current-residual monitor"
    default n

config ECU_COOLING_VALIDATED
    bool "Claim validated cooling loop"
    default n

config ECU_RTOS_MEMORY_VALIDATED
    bool "Claim validated RTOS memory/stack budgets"
    default n

config ECU_WCET_VALIDATED
    bool "Claim validated worst-case execution timing"
    default n

config ECU_CAN_LOAD_VALIDATED
    bool "Claim validated whole-vehicle CAN load"
    default n

config ECU_WATCHDOG_VALIDATED
    bool "Claim validated watchdog behavior"
    default n

config ECU_SAFE_OUTPUTS_VALIDATED
    bool "Claim validated safe-output behavior"
    default n

config ECU_CM200_CAN_CONTRACT_VALIDATED
    bool "Claim measured CM200 broadcast IDs/rates/mode/counter settings"
    default n

endmenu

menu "DRG27 ECU migration capabilities"

# Hidden migration facts. Deliberately not user-selectable: code presence,
# actor liveness, safety evidence and physical validation are four different
# states and must never be inferred from one another.

config ECU_CAP_FAIL_LOW_ADAPTER_PRESENT
    bool
    default y
    help
      E-003: the board-owned direct-register safe-output primitive exists and
      is registered at PRE_KERNEL_1. This states only that the adapter is
      present; it does NOT claim physical validation on the target.

config ECU_CAP_FAIL_LOW_PHYSICALLY_VALIDATED
    bool
    default n
    help
      Set only after scope verification on the installed ECU: all five outputs
      low before kernel init, and again after a forced fatal error.

config ECU_CAP_SAFETY_IO_ADAPTER_PRESENT
    bool
    default n

config ECU_CAP_DISCRETE_IN_ADAPTER_PRESENT
    bool
    default n

config ECU_CAP_ANALOG_ADAPTER_PRESENT
    bool
    default n

config ECU_CAP_ANALOG_ACTOR_LIVE
    bool
    default n

config ECU_CAP_ANALOG_SAFETY_EVIDENCE
    bool
    default n

config ECU_CAP_CAN_ADAPTER_PRESENT
    bool
    default n

config ECU_CAP_CAN_RX_ACTOR_LIVE
    bool
    default n

config ECU_CAP_CAN_TX_ACTOR_LIVE
    bool
    default n

config ECU_CAP_CAN_ONWIRE_COMMIT_PROVEN
    bool
    default n
    help
      Set only when the E-013 audit has demonstrated that the transmit path
      credits a CM200 frame exclusively on confirmed on-wire completion.

config ECU_CAP_WATCHDOG_ADAPTER_PRESENT
    bool
    default n

config ECU_CAP_WATCHDOG_ACTIVE
    bool
    default n

config ECU_CAP_LOGGER_ADAPTER_PRESENT
    bool
    default n

endmenu
```

## prj.conf
```kconfig
# ---------------------------------------------------------------------------
# E-001/E-002 base configuration
# ---------------------------------------------------------------------------

CONFIG_SERIAL=y
CONFIG_CONSOLE=y
CONFIG_UART_CONSOLE=y
CONFIG_PRINTK=y

CONFIG_GPIO=y

CONFIG_ASSERT=y

# ---------------------------------------------------------------------------
# Authority lock (E-003 adds C BUILD_ASSERT backstops)
# ---------------------------------------------------------------------------

CONFIG_ECU_TORQUE_AUTHORITY=n
CONFIG_ECU_INVERTER_ENABLE_AUTHORITY=n
CONFIG_ECU_FIRMWARE_OK_AUTHORITY=n

# ---------------------------------------------------------------------------
# Static runtime
# ---------------------------------------------------------------------------
#
# The v2.10.7 oracle is fully static (StaticTask_t / StaticQueue_t) and already
# enforces that with a CI gate. The Zephyr runtime keeps the same property.

CONFIG_HEAP_MEM_POOL_SIZE=0

CONFIG_THREAD_NAME=y
CONFIG_THREAD_STACK_INFO=y
CONFIG_INIT_STACKS=y

# ---------------------------------------------------------------------------
# Peripherals not yet owned by this migration stage
# ---------------------------------------------------------------------------
#
# ADC ownership is an open decision recorded in the E-000 plan (seam 4.2): the
# generic subsystem stays out until E008_ADC_OWNERSHIP_AUDIT.md concludes.

CONFIG_ADC=n
CONFIG_CAN=n
CONFIG_PWM=n
CONFIG_SPI=n
CONFIG_I2C=n
CONFIG_WATCHDOG=n
```

## src/main.c
```c
#include <zephyr/kernel.h>
#include <zephyr/sys/printk.h>
#include <zephyr/devicetree.h>

#include <ecu_core/ecu_core_contract.h>

#include "ecu_fatal.h"

#include <ecu_platform/fail_low.h>

/*
 * Authority backstop.
 *
 * The Kconfig locks are the policy; these assertions make a mis-set
 * configuration a build failure rather than a runtime discovery. They are
 * duplicated at each output writer as those stages land.
 */
BUILD_ASSERT(!IS_ENABLED(CONFIG_ECU_TORQUE_AUTHORITY),
             "torque authority must remain disabled during the migration");
BUILD_ASSERT(!IS_ENABLED(CONFIG_ECU_INVERTER_ENABLE_AUTHORITY),
             "inverter enable authority must remain disabled during the migration");
BUILD_ASSERT(!IS_ENABLED(CONFIG_ECU_FIRMWARE_OK_AUTHORITY),
             "Firmware_Ok authority must remain disabled during the migration");

int main(void)
{
    int ret;

    printk("\nDRG27 Placidusax ECU - Zephyr migration stage E-003a\n");
    printk("Oracle: %s\n", ECU_CORE_ORACLE_REVISION);
    printk("Board:  %s\n", CONFIG_BOARD_TARGET);

    ret = ecu_core_contract_check();

    if (ret != 0) {
        printk("ECU portable core contract FAILED: %d\n", ret);
        k_panic();
    }

    printk("ECU portable core: contract PASS\n");

    /*
     * Frozen DER26 clock contract, asserted from Devicetree rather than
     * trusted. v2.10.7 SystemClock_Config(): HSE 8 MHz crystal, PLL
     * M=4 N=216 P=2 -> 216 MHz SYSCLK, AHB /1, APB1 /4, APB2 /2.
     */
    printk("SYSCLK: %u Hz\n",
           (unsigned int)DT_PROP(DT_NODELABEL(rcc), clock_frequency));

    printk("Torque authority:          DISABLED\n");
    printk("Inverter enable authority: DISABLED\n");
    printk("Firmware_Ok authority:     DISABLED\n");
    if (!ecu_safe_outputs_confirmed()) {
        /*
         * The PRE_KERNEL_1 board primitive did not run, so the outputs were
         * never proven safe. Treat that as fatal rather than continuing with
         * an unknown physical state.
         */
        printk("ECU safe outputs NOT confirmed\n");
        k_panic();
    }

    /* Named by schematic net: MCU Breakout rev1 assigns no function to the
     * generic nets, so neither does this banner. */
    printk("Safe outputs LOW: Firmware_Ok(PA7) MTR_EN(PF10) Buzzer(PF13) "
           "MISC_IO4(PA5) GP_OUT6(PB8)\n");
    printk("Safe-output drift: reasserts=%u last_mismatch=0x%02x\n",
           (unsigned int)ecu_safe_outputs_reassert_count(),
           (unsigned int)ecu_safe_outputs_last_mismatch());

    for (;;) {
        k_sleep(K_FOREVER);
    }

    return 0;
}
```

## src/ecu_fatal.c
```c
/*
 * Application-owned fatal policy.
 *
 * The app owns the ORDERING of fatal actions; the board owns the physical
 * mechanism. This file must therefore never touch MCU registers directly --
 * it calls the board primitive through the narrow platform interface.
 */

#include "ecu_fatal.h"

#include <ecu_platform/fail_low.h>

#include <zephyr/arch/cpu.h>
#include <zephyr/fatal.h>
#include <zephyr/init.h>
#include <zephyr/kernel.h>
#include <zephyr/sys/printk.h>

/*
 * Authority backstop at the fatal path itself. A build that somehow enabled an
 * authority lock must not reach a fatal handler that assumes outputs are safe.
 */
BUILD_ASSERT(!IS_ENABLED(CONFIG_ECU_TORQUE_AUTHORITY),
             "torque authority must remain disabled during the migration");
BUILD_ASSERT(!IS_ENABLED(CONFIG_ECU_INVERTER_ENABLE_AUTHORITY),
             "inverter enable authority must remain disabled during the migration");

/* Set once the PRE_KERNEL_1 primitive has been observed to have run. */
static bool safe_outputs_confirmed;

void k_sys_fatal_error_handler(unsigned int reason, const struct arch_esf *esf)
{
    ARG_UNUSED(esf);

    /*
     * Outputs first, diagnostics second. Console output can block, recurse or
     * fault; nothing may run ahead of driving the vehicle outputs safe.
     */
    ecu_force_safe_outputs_direct();

    printk("\n*** ECU FATAL %u - safe outputs forced ***\n", reason);

    /*
     * Re-assert after the console write. Anything reached during printk may
     * have touched a shared peripheral, and this primitive is idempotent.
     */
    ecu_force_safe_outputs_direct();

    /*
     * Spin with interrupts masked, as the oracle's stack-overflow and
     * malloc-failure hooks do. Two things about this are NOT transcription and
     * are recorded as decisions:
     *
     * 1. Blast radius. The oracle had two narrow hooks; Zephyr routes every
     *    fatal here - CPU faults, k_panic, k_oops, stack canary failures and
     *    __ASSERT. Zephyr could abort just the offending thread for a
     *    thread-scoped K_ERR_KERNEL_OOPS; spinning the system gives that up
     *    deliberately, because a vehicle controller running on after an
     *    unexplained fault is worse than one that stops.
     *
     * 2. What ends the spin. IWDG is independent of the core and keeps
     *    counting through irq_lock(), so once E-015 arms it this is
     *    reset-in-N-ms, not hang-forever. Until E-015 lands, IWDG is NOT
     *    armed and this really is dead-until-power-cycle.
     *
     * BLOCKING, tracked in the deviation register: whether a spinning ECU
     * still holds the shutdown loop closed. If this board's contribution is a
     * static GPIO level, dead firmware holds HV live; if it is a strobe or
     * charge pump that decays when the CPU stops toggling, it is safe by
     * construction. Needs Shutdown rev2. Driving Firmware_Ok low above is
     * necessary but is only sufficient in the static-level case.
     */
    (void)irq_lock();

    for (;;) {
        /* Deliberate: hold outputs low until the watchdog or a manual reset. */
    }
}

bool ecu_safe_outputs_confirmed(void)
{
    return safe_outputs_confirmed;
}

/*
 * Runs after the board primitive's PRE_KERNEL_1 registration. Its only job is
 * to record that the earlier stage was reached, so main() can report the fact
 * rather than assume it.
 */
static int ecu_fatal_policy_init(void)
{
    /*
     * Detect-then-fix rather than blind re-assert. If a PRE_KERNEL_1 device
     * initialization between the board primitive and here reconfigured a
     * shared GPIO port, the mismatch is counted and reported by main() instead
     * of being silently repaired. During bring-up that answers whether this
     * guard is needed at all: never fires by end of season -> delete it;
     * fires -> an init-ordering bug that would otherwise be invisible.
     */
    ecu_safe_outputs_verify_and_restore();
    safe_outputs_confirmed = true;
    return 0;
}

SYS_INIT(ecu_fatal_policy_init, PRE_KERNEL_2, 0);
```

## src/ecu_fatal.h
```c
#ifndef DRG27_ECU_FATAL_H_
#define DRG27_ECU_FATAL_H_

#include <stdbool.h>

#ifdef __cplusplus
extern "C" {
#endif

/*
 * True once the safe-output primitive has been re-asserted at PRE_KERNEL_2,
 * confirming the board's PRE_KERNEL_1 registration was reached.
 */
bool ecu_safe_outputs_confirmed(void);

#ifdef __cplusplus
}
#endif

#endif /* DRG27_ECU_FATAL_H_ */
```
